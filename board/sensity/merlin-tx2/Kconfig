## board/sensity/merlin-tx2/Kconfig
```kconfig
# Copyright (c) 2018 Verizon Communications, Inc.
#
# SPDX-License-Identifier: GPL-2.0

if TARGET_SENSITY_MERLIN_TX2

config SYS_BOARD
	default "merlin-tx2"

config SYS_VENDOR
	default "sensity"

config SYS_CONFIG_NAME
	default "sensity-merlin-tx2"

config MANUFACTURING
	bool "Build for manufacturing use"

endif
```

## board/sensity/merlin/Kconfig
```kconfig
if TARGET_SENSITY_MERLIN

config SYS_BOARD
	default "merlin"

config SYS_VENDOR
	default "sensity"

config SYS_CONFIG_NAME
	default "sensity-merlin"

config MANUFACTURING
	bool "Build for manufacturing use"

config SECURE_BOOT_ONLY
	bool "Build for secure boot - no legacy images"

endif
```

## configs/sensity-merlin_defconfig
```kconfig
CONFIG_ARM=y
CONFIG_TEGRA=y
CONFIG_TEGRA210=y
CONFIG_TARGET_SENSITY_MERLIN=y
CONFIG_DEFAULT_DEVICE_TREE="tegra210-sensity-merlin"
CONFIG_USE_PRIVATE_LIBGCC=n
CONFIG_NVTBOOT=y
CONFIG_CMD_NET=y
```
